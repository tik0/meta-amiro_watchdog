## conf/machine/amiro.conf
```bitbake
#@TYPE: Machine
#@NAME: AMiRo machine
#@DESCRIPTION: Machine configuration for the AMiRo mini robot board 

EXTRA_IMAGEDEPENDS += "u-boot"

# Uncomment the following line to enable the hard floating point abi. Note that
# this breaks some binary libraries and 3D (neither of which ship with
# meta-yocto). For maximum compatibility, leave this disabled.
DEFAULTTUNE ?= "cortexa8hf-neon"
include conf/machine/include/tune-cortexa8.inc

IMAGE_FSTYPES += "img"

SERIAL_CONSOLE = "115200 ttyO2"

PREFERRED_PROVIDER_virtual/kernel ?= "linux-yocto"
PREFERRED_VERSION_linux-yocto ?= "3.14%"

KERNEL_IMAGETYPE = "zImage"
KERNEL_DEVICETREE = "omap3-overo-summit.dtb omap3-overo-amiro.dtb"

PREFERRED_PROVIDER_virtual/bootloader ?= "u-boot"
PREFERRED_VERSION_u-boot ?= "v2014.10%"

UBOOT_MACHINE = "omap3_overo_defconfig"
UBOOT_ENTRYPOINT = "0x80008000"
UBOOT_LOADADDRESS = "0x80008000"

UBOOT_SUFFIX = "img"

SPL_BINARY = "MLO"

MACHINE_FEATURES = "\
    alsa \
    apm \
    bluetooth \
    can \
    ext2 \
    ext3 \
    ext4 \
    vfat \
    serial \
    usbgadget \
    usbhost \
    uboot \
    wifi \
    "

MACHINE_EXTRA_RRECOMMENDS = "\
    kernel-devicetree \
    linux-firmware-wl12xx \
    ti-wifi-utils \
    kernel-module-bluetooth \
    kernel-module-bnep \
    kernel-module-hci-uart \
    kernel-module-can \
    kernel-module-can-raw \
    kernel-module-can-dev \
    kernel-module-can-gm \
    kernel-module-can-bcm \
    kernel-module-vcan \
    kernel-module-mcp251x \
    kernel-module-media \
    kernel-module-omap3-isp \
    kernel-module-ov5647 \
    kernel-module-ov9650 \
    kernel-module-ov9655 \
    kernel-module-mt9v032 \
    kernel-module-wl12xx \
    kernel-module-wlcore \
    kernel-module-wlcore-sdio \
    kernel-module-lib80211 \
    kernel-module-m25p80 \
    kernel-module-at24 \
    kernel-module-musb-hdrc \
    kernel-module-g-ether \
    kernel-module-usb-f-ecm \
    kernel-module-usb-f-eem \
    kernel-module-phy-nop \
    kernel-module-phy-omap-control \
    kernel-module-phy-omap-usb2 \
    kernel-module-phy-twl4030-usb \
    kernel-module-pwm-twl-led \
    kernel-module-pwm-twl \
    kernel-module-emif \
    kernel-module-snd-soc-core \
    kernel-module-snd-soc-omap \
    kernel-module-snd-soc-omap-mcbsp \
    kernel-module-snd-soc-omap-twl4030 \
    kernel-module-snd-soc-twl4030 \
    kernel-module-snd-soc-tpa2012 \
    \
    linux-firmware \
    kernel-modules \
    ov5647 \
    "
```
